## Kconfig
```kconfig
config PROSPECTOR_LAYER_ROLLER_ALL_CAPS
    bool "Convert layer names to all caps"
    default n
```

## boards/shields/prospector_adapter/Kconfig.defconfig
```kconfig
if SHIELD_PROSPECTOR_ADAPTER

config ZMK_SPLIT_BLE_CENTRAL_BATTERY_LEVEL_FETCHING
    default y

config ZMK_DISPLAY
    default y

choice ZMK_DISPLAY_STATUS_SCREEN
    default ZMK_DISPLAY_STATUS_SCREEN_CUSTOM
endchoice

config ZMK_DISPLAY_STATUS_SCREEN_CUSTOM
    select LV_USE_LABEL
    select LV_USE_BAR
    select LV_USE_FLEX
    select LV_USE_ROLLER
    select LV_COLOR_SCREEN_TRANSP

choice ZMK_DISPLAY_WORK_QUEUE
    default ZMK_DISPLAY_WORK_QUEUE_DEDICATED
endchoice

config ZMK_DISPLAY_DEDICATED_THREAD_STACK_SIZE
    default 4096

choice ST7789V_PIXEL_FORMAT
    default ST7789V_RGB565
endchoice

config LV_Z_VDB_SIZE
    default 100

config LV_Z_MEM_POOL_SIZE
    default 10000

config LV_DPI_DEF
    default 261

config LV_Z_BITS_PER_PIXEL
    default 16

# Force 16-bit color depth (symbol from upstream LVGL choice)
config LV_COLOR_DEPTH_16
    default y

# (Remove the local 'choice LV_COLOR_DEPTH' block you had; it can shadow the real one)

config LV_COLOR_16_SWAP
    depends on LV_COLOR_DEPTH_16
    default y

config LV_DISP_DEF_REFR_PERIOD
    default 20

choice LV_FONT_DEFAULT
    default LV_FONT_DEFAULT_MONTSERRAT_20
endchoice

config PWM
    default y

config LED
    default y

config PROSPECTOR_USE_AMBIENT_LIGHT_SENSOR
    select SENSOR
    select APDS9960

endif

config ZMK_SPLIT_BLE_PERIPHERAL_COUNT
    int
    default 2
```
